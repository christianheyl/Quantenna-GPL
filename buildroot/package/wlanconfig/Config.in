## buildroot/package/wlanconfig/Config.in
```kconfig
config BR2_PACKAGE_WLANCONFIG
	bool "wlanconfig"
	default n
	help
	  A program for creating virtual wireless interfaces.

	  Sourced from the MadWifi driver.
```

## buildroot/package/wpa_supplicant/Config.in
```kconfig
config BR2_PACKAGE_WPASUPPLICANT
	bool "wpa_supplicant"
	default y
	help
	  EAP client
```

## buildroot/package/zhostapd/Config.in
```kconfig
config BR2_PACKAGE_ZHOSTAPD
	bool "zhostapd"
	default y
	help
	  EAP, RADIUS client, etc.

	  Sourced from the Prism driver.
```

## buildroot/package/zminihttpd/Config.in
```kconfig
config BR2_PACKAGE_MINIHTTPD
	bool "minihttpd"
	default n
	help
	  Quantenna Http Server
```

## buildroot/target/device/Quantenna/Config.in
```kconfig
config BR2_TARGET_RUBY
	bool "Ruby filesystem patches"
	default n
	help
	  Amend the filesystem with configurable patches.

if BR2_TARGET_RUBY
	source "target/device/Quantenna/Ruby/Config.in"
endif
```

## buildroot/target/device/Quantenna/Ruby/Config.in
```kconfig
menu "Ruby filesystem configuration"

config BR2_TARGET_RUBY_IPC_SUBNET
	string "IPC point-to-point subnet"
	default 192.168.101
	help
	  The IPC driver automatically creates a point-to-point
	  network interface for communication between network
	  stacks on the two Ruby processors. The point-to-point
	  interface is given an IP address.

choice
	prompt "IP address on SOC1 Ethernet"
	default BR2_TARGET_RUBY_SOC1_ETH_IP_DHCP
	help
	
config BR2_TARGET_RUBY_SOC1_ETH_IP_NONE
	bool "none"
	
config BR2_TARGET_RUBY_SOC1_ETH_IP_STATIC
	bool "static"
	
config BR2_TARGET_RUBY_SOC1_ETH_IP_DHCP
	bool "dhcp"

endchoice

if BR2_TARGET_RUBY_SOC1_ETH_IP_STATIC

config BR2_TARGET_RUBY_SOC1_ETHERNET_IP_ADDRESS
	string "IP address for Ethernet interface on SOC1"
	help
	  Static IP address for Ethernet interface on SOC1.

endif

choice
	prompt "IP address on SOC2 Ethernet"
	default BR2_TARGET_RUBY_SOC2_ETH_IP_NONE
	help
	
config BR2_TARGET_RUBY_SOC2_ETH_IP_NONE
	bool "none"
	
config BR2_TARGET_RUBY_SOC2_ETH_IP_STATIC
	bool "static"
	
config BR2_TARGET_RUBY_SOC2_ETH_IP_DHCP
	bool "dhcp"

endchoice

if BR2_TARGET_RUBY_SOC2_ETH_IP_STATIC

config BR2_TARGET_RUBY_SOC2_ETHERNET_IP_ADDRESS
	string "IP address for Ethernet interface on SOC2"
	help
	  Static IP address for Ethernet interface on SOC2.

endif

config BR2_TARGET_RUBY_STATELESS
	bool "Stateless"
	default n

config BR2_TARGET_RUBY_STATELESS_HOST
	bool "Host of stateless board"
	default n

endmenu
```

## drivers/ruby/Kconfig
```kconfig
#
# Quantenna Ruby board
#

menu "Quantenna"

config QUANTENNA_RUBY
	bool "Quantenna Ruby board support"
	select WEXT_PRIV
	select WIRELESS_EXT

config ARCH_RUBY_NUMA
	bool "Support of Ruby non-unified memory architecture"

config QVSP
	bool "Video Stream Protection"
	help
	  Advanced stream protection feature.

config RUBY_PCIE_TARGET
	bool "Include the PCIe target driver for board with a PCIe interface"
	help
	  A build for a board with a PCIe interface must select this option

config RUBY_PCIE_HOST
	bool "Include the PCIe host driver for board with a PCIe interface"
	help
	  A build for a board with a PCIe RootComplex support must select this option

config TOPAZ_PCIE_TARGET
	bool "Include the topaz PCIe target driver for board with a PCIe interface"
	help
	  A build for a board with a topaz PCIe interface must select this option

config TOPAZ_PCIE_HOST
	bool "Include topaz PCIe host interface for TOPAZ RC Host"
		help
			  A build for a board with a topaz PCIe RC Host support must select this option
config PCIEPORTBUS
	depends on TOPAZ_PCIE_HOST
	bool "Include generic PCIe driver"
	default y

config TOPAZ_DBDC_HOST
	bool "include topaz DBDC host interface for TOPAZ RC Host"
	help
	  A build for a board with a topaz RC Host support for DBDC must select this option

config ARCH_RUBY_SRAM_IRQ_STACK
	bool "Use dedicated SRAM stack for interrupts" if (!ARCH_ARC_LV2_INTR && ARCH_ARC_CURR_IN_REG && !PREEMPT)

config KERNEL_TEXT_SNAPSHOTS
	bool "Take snapshots of kernel text section to detect corruption"
	default n
	help
	  Create /proc/kdump, which is a human readable hex readout
	  of the kernel text section. Reading this several times then
	  using diff utilities on the output can show which kernel
	  text is being corrupted. Also allows kernel text section
	  snapshots to be taken for analysis in the troubleshooting
	  crash handler.

config KERNEL_TEXT_SNAPSHOT_COUNT
	int "Number of snapshots to hold"
	default 2
	depends on KERNEL_TEXT_SNAPSHOTS
	help
	  How many kernel text section snapshots to keep. More can be
	  added if suspicious of particular areas of code corrupting
	  and before and after shots are desired to check. Each snapshot
	  adds several MB of data size.

config ARCH_RUBY_EMAC_LIB
	tristate "Common Arasan EMAC routines for Ruby / Topaz"
	default y
	help
	  Routines common to Ruby and Topaz EMAC drivers. Includes PHY
	  routines, initialization, PHY/MII/MDIO routines.

config ARCH_RUBY_EMAC
	tristate "Ruby Arasan EMAC driver"
	default y
	select ARCH_RUBY_EMAC_LIB
	help
	  Ruby Arasan EMAC AHB driver

config ARCH_RUBY_EMAC_SMOOTHING
	bool "Enable Arasan EMAC traffic bursts smoothing"
	default y
	depends on ARCH_RUBY_EMAC

config ARCH_RUBY_EMAC_SMOOTHING_BURST_SIZE
	int "Number of packets per burst"
	default 48
	depends on ARCH_RUBY_EMAC_SMOOTHING

config ARCH_RUBY_EMAC_SMOOTHING_RATE
	int "Number of packets per second"
	default 50000
	depends on ARCH_RUBY_EMAC_SMOOTHING

config QUANTENNA_RESTRICT_WLAN_IP
	bool "Restrict incoming IP packets on the WLAN interface for RGMII bridge operation"
	default n
	help
	Restrict the incoming IP traffic on the WLAN interface to prevent access to the
	bridge interface on RGMII boards.

config SWITCH_RTL8365MB
	tristate "Realtek RTL8365MB switch"
	default n
	depends on ARCH_RUBY_EMAC
	help
	  Realtek RTL8365MB driver

config SWITCH_RTL8363SB
	tristate "Realtek RTL8363SB switch"
	default n
	depends on ARCH_RUBY_EMAC
	help
	  Realtek RTL8363SB driver

endmenu

source "drivers/pci/pcie/Kconfig"
```

## drivers/topaz/Kconfig
```kconfig
#
# Quantenna Topaz board
#

menu "Quantenna Topaz"

config QUANTENNA_TOPAZ
	bool "Quantenna Topaz chipset support"
	select QUANTENNA_RUBY
	default n
	help
	  Additional drivers for Quantenna Topaz accelerated datapath

config ARCH_TOPAZ_FWT
	tristate "Topaz FWT driver"
	depends on QUANTENNA_TOPAZ
	default y
	help
	  Topaz Forwarding Table Driver

config ARCH_TOPAZ_TQE
	tristate "Topaz TQE driver"
	depends on QUANTENNA_TOPAZ
	select ARCH_TOPAZ_FWT
	default y
	help
	  Topaz Transmit Queueing Engine Driver

config ARCH_TOPAZ_SWITCH_TEST
	tristate "Topaz Switch Test Modules"
	depends on ARCH_TOPAZ_TQE
	default n
	help
	  A set of test modules to control the various Topaz
	  accelerated datapath elements

config ARCH_TOPAZ_EMAC
	tristate "Topaz Arasan EMAC driver"
	depends on QUANTENNA_TOPAZ
	default y
	select ARCH_RUBY_EMAC_LIB
	select ARCH_TOPAZ_TQE
	help
	  Topaz Arasan EMAC AHB driver

endmenu
```
