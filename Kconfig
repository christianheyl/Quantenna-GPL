## Kconfig
```kconfig
mainmenu "RUBY system configuration"

menu "Filesystem & toolchain"

source "buildroot/@@"
source "Config.in"
source "@@"

endmenu

menu "Busybox configuration"

source "buildroot/package/busybox/busybox-1.10.3/@CONFIG_@"
source "Config.in"
source "@@"

endmenu
```

## buildroot/package/dfs_daemon/Config.in
```kconfig
config BR2_PACKAGE_DFS_DAEMON
	bool "DFS_DAEMON"
	default n
	help
	  Quantenna DFS Daemon, including DFS Re-entry.
```

## buildroot/package/dhcp/Config.in
```kconfig
config BR2_PACKAGE_DHCP_SERVER
	bool "dhcp server"
	default n
	help
	  DHCP server from the ISC DHCP distribution.


config BR2_PACKAGE_DHCP_RELAY
	bool "dhcp relay"
	default n
	help
	  DHCP relay agent from the ISC DHCP distribution.


config BR2_PACKAGE_DHCP_CLIENT
	bool "dhcp client"
	default y
	help
	  DHCP client from the ISC DHCP distribution.
```

## buildroot/package/igmpproxy/Config.in
```kconfig
config BR2_PACKAGE_IGMPPROXY
	bool "igmpproxy"
	default n
	help
		IGMP proxy code
```

## buildroot/package/libnet/Config.in
```kconfig
config BR2_PACKAGE_LIBNET
	bool "Lib NET"
	default n
	help
		lib_net shared lib.
```

## buildroot/package/miidl/Config.in
```kconfig
config BR2_PACKAGE_MIIDL
	bool "miidl"
	default n
	help
	  MII/RGMII userspace boot utility to load images
	  towards target qdevices
```

## buildroot/package/mswbsp/Config.in
```kconfig
config BR2_PACKAGE_MSWBSP
	bool "MS Wireless BSP"
	default y
	help
	  Quantenna RPC for MS Wireless BSP.
```

## buildroot/package/nemesis/Config.in
```kconfig
config BR2_PACKAGE_NEMESIS
	bool "Nemesis"
	default n
	help
		Nemesis IGMP generator
```

## buildroot/package/ntpclient/Config.in
```kconfig
config BR2_PACKAGE_NTPCLIENT
	bool "NTP client"
	default n
	help
	  Simple, small NTP client
```

## buildroot/package/php/Config.in
```kconfig
config BR2_PACKAGE_PHP
	bool "php"
	default n
	help
	  PHP

	  http://www.php.org/
```

## buildroot/package/q_utils/Config.in
```kconfig
config BR2_PACKAGE_Q_UTILS
	bool "q_utils"
	default y
	select BR2_PACKAGE_WIRELESS_TOOLS
	help
	  Quantenna Utility Applications
```

## buildroot/package/qcsapi/Config.in
```kconfig
config BR2_PACKAGE_QCSAPI
	bool "qcsapi"
	default y
	help
	  Quantenna Configuration and Status API.

config BR2_PACKAGE_CALL_QCSAPI_RPC_SOCKET_CLIENT
	bool "call_qcsapi_sockrpc"
	default n
	help
	  RPC client for call_qcsapi, using UDP sockets

config BR2_PACKAGE_CALL_QCSAPI_RPC_PCIE_CLIENT
	bool "call_qcsapi_pcie"
	default n
	help
	  RPC client for call_qcsapi, using PCIE

config BR2_PACKAGE_CALL_QCSAPI_RPC_RAW_SOCKET_CLIENT
	bool "call_qcsapi_sockraw"
	default n
	help
	  RPC client for call_qcsapi, using raw sockets

config BR2_PACKAGE_CALL_QCSAPI_RPC_SERVER
	bool "call_qcsapi_rpcd"
	default n
	help
	  RPC server for all call_qcsapi RPC clients

config BR2_PACKAGE_QCSAPI_RPC_SOCKET_CLIENT
	bool "qcsapi_sockrpc"
	default n
	help
	  RPC client for libqcsapi, using UDP sockets

config BR2_PACKAGE_QCSAPI_RPC_PCIE_CLIENT
	bool "qcsapi_pcie"
	default n
	help
	  RPC client for libqcsapi, using PCIE

config BR2_PACKAGE_QCSAPI_RPC_RAW_SOCKET_CLIENT
	bool "qcsapi_sockraw"
	default n
	help
	  RPC client for libqcsapi, using raw sockets

config BR2_PACKAGE_QCSAPI_RPC_SERVER
	bool "qcsapi_rpcd"
	default n
	help
	  RPC server for all qcsapi RPC clients

config BR2_PACKAGE_QCSAPI_MONITOR_RFENABLE
	bool "qcsapi_monitor_rfenable"
	default n
	help
	  QCSAPI monitor_rfenable binary
```

## buildroot/package/qeventd/Config.in
```kconfig
config BR2_PACKAGE_QEVENTD
	bool "Quantenna private events daemon"
	default y
	help
	  A daemon to manage Quantenna private events
```

## buildroot/package/qharvest/Config.in
```kconfig
config BR2_PACKAGE_QHARVEST
	bool "Qharvest"
	default n
	help
	  Quantenna Harvest.
```

## buildroot/package/qtn_fw/Config.in
```kconfig
config BR2_PACKAGE_QTN_MACFW
	bool "Ruby MuC Firmware"
	default y
	help
	  Include MuC firmware in target image

config BR2_PACKAGE_QTN_DSPFW
	bool "Ruby DSP Firmware"
	default y
	help
	  Include dsp firmware in target image

config BR2_PACKAGE_QTN_UBOOT
	bool "Ruby u-boot binary"
	default n
	help
	  Include u-boot binary in target image

config BR2_PACKAGE_QTN_AUCFW
	bool "Ruby AUC Firmware"
	default n
	help
	  Include auc firmware in target image

config BR2_PACKAGE_QTN_UBOOT_UPGRADE_SCRIPT
	bool "Ruby full u-boot updating script"
	default n
	help
	  Include full u-boot updating script in target image

config BR2_PACKAGE_QTN_MINI_UBOOT_UPGRADE_SCRIPT
	bool "Ruby mini u-boot updating script"
	default n
	help
	  Include mini u-boot updating script in target image

config BR2_PACKAGE_QTN_LINUX_IMG
	bool "Ruby linux image on target"
	default n
	help
	  Include a linux firmware image on the device. These
	  would typically be served to PCIe or RGMII target modules
	  with limited flash space of their own

config BR2_PACKAGE_QTN_LINUX_IMG_CONFIG
	string "Config to copy child image"
	default "ruby_config"
	depends BR2_PACKAGE_QTN_LINUX_IMG
	help
	  What config to use on the child image

config BR2_PACKAGE_QTN_PREPOPULATE
	bool "Prepopulate filesystem with test data"
	default n
	help
	  Pre-populate filesystem with temporary data
```

## buildroot/package/qwe/Config.in
```kconfig
config BR2_PACKAGE_QWE_PAL
        bool "QWE PAL"
        default n
        help
          Quantenna Wireless Extension Platform Abstract Layer
```

## buildroot/package/qweadapter/Config.in
```kconfig
config BR2_PACKAGE_QWE_ADAPTER
        bool "QWE Adapter"
        default n
        help
          Quantenna Wireless Extension Adapter
```

## buildroot/package/qwebcgiif/Config.in
```kconfig
config BR2_PACKAGE_QWEBCGIIF
	bool "qwebcgiif"
	default y
	help
	  Quantenna CGI Web interface.
```

## buildroot/package/qwebphpif/Config.in
```kconfig
config BR2_PACKAGE_QWEBPHPIF
	bool "qwebphpif"
	default y
	help
	  Quantenna PHP Web interface.
```

## buildroot/package/qwebphpif24/Config.in
```kconfig
config BR2_PACKAGE_QWEBPHPIF24
	bool "qwebphpif24"
	default n
	help
           Quantenna PHP Web interface for QV860.
```

## buildroot/package/rmt_qcsapi/Config.in
```kconfig
config BR2_PACKAGE_RMT_QCSAPI
	bool "rmt_qcsapi"
	default n
	help
	  Remote Qcsapi Client for Quantenna MII Module
```

## buildroot/package/rmt_qcsapi_server/Config.in
```kconfig
config BR2_PACKAGE_RMT_QCSAPI_SERVER
	bool "rmt_qcsapi_server"
	default n
	help
	  Remote Qcsapi Server for Quantenna MII Module
```

## buildroot/package/sigma/Config.in
```kconfig
config BR2_PACKAGE_SIGMA
	bool "sigma"
	default n
	depends on BR2_PACKAGE_QCSAPI
	help
	  Sigma control agent.

config BR2_PACKAGE_SIGMA_CA_PORT
	int "CA port"
	default 9000
	depends on BR2_PACKAGE_SIGMA
	help
	  port which will be listened by sigma CA

config BR2_PACKAGE_SIGMA_DUT_PORT
	int "DUT port"
	default 6070
	depends on BR2_PACKAGE_SIGMA
	help
	  port which will be listened by sigma DUT agent
```

## buildroot/package/testipc/Config.in
```kconfig
config BR2_PACKAGE_TESTIPC
	bool "testipc"
	default n
	help
	  Test IPC client driver
```
